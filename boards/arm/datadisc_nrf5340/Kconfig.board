## boards/arm/datadisc_nrf5340/Kconfig.board
```kconfig
# DataDisc v2 NRF5340 board configuration

# Copyright (c) 2020-2022 Griffin Adams
# SPDX-License-Identifier: Apache-2.0

if SOC_NRF5340_CPUAPP_QKAA

config BOARD_DATADISC_NRF5340_CPUAPP
	bool "DataDisc v2 nRF5340 Application MCU"

endif # SOC_NRF5340_CPUAPP_QKAA

config BOARD_DATADISC_NRF5340_CPUNET
	bool "DataDisc v2 NRF5340 Network MCU"
	depends on SOC_NRF5340_CPUNET_QKAA
```

## boards/arm/datadisc_nrf5340/datadisc_nrf5340_cpuapp_defconfig
```kconfig
# Copyright (c) 2021-2022 Griffin Adams
# SPDX-License-Identifier: Apache-2.0

CONFIG_SOC_SERIES_NRF53X=y
CONFIG_SOC_NRF5340_CPUAPP_QKAA=y
CONFIG_BOARD_DATADISC_NRF5340_CPUAPP=y

# Enable MPU
CONFIG_ARM_MPU=y

# Enable hardware stack protection
CONFIG_HW_STACK_PROTECTION=y

# Enable TrustZone-M
CONFIG_ARM_TRUSTZONE_M=y

# configure internal caps
CONFIG_SOC_LFXO_CAP_INT_6PF=y

CONFIG_SOC_HFXO_CAP_INTERNAL=y
CONFIG_SOC_HFXO_CAP_INT_VALUE_X2=32

# configure pin control
CONFIG_PINCTRL=y
```

## child_image/mcuboot/boards/datadisc_nrf5340_cpuapp.conf
```kconfig
#
# Copyright (c) 2022 Griffin Adams
#
# SPDX-License-Identifier: Apache-2.0
#


# The following configurations are required to support simultaneous multi image update
CONFIG_PCD_APP=y
CONFIG_UPDATEABLE_IMAGE_NUMBER=2
CONFIG_FLASH_SIMULATOR=y
CONFIG_FLASH_SIMULATOR_DOUBLE_WRITES=y
CONFIG_FLASH_SIMULATOR_STATS=n
CONFIG_BOOT_UPGRADE_ONLY=y

CONFIG_SIZE_OPTIMIZATIONS=y
```

## drivers/bm1422/Kconfig
```kconfig
# 3-Axis, +/-1200uT Digital Magnetometer

# Copyright (c) 2021 Griffin Adams
# SPDX-License-Identifier: Apache-2.0

menuconfig BM1422
	bool "BM1422AGMV Three Axis I2C Magnetometer"
	depends on I2C
	help
		Enable driver for BM1422 Three-Axis Digital Magnetometers.

if BM1422

module = BM1422
module-str = BM1422
source "subsys/logging/Kconfig.template.log_config"

choice
	prompt "Output Data Bit"
	default BM1422_12_BIT

	config BM1422_12_BIT
		bool "12-bit Output"
		  
	config BM1422_14_BIT
		bool "14-bit Output"
		  
endchoice

choice
	prompt "Averaging Filter Control"
	default BM1422_AVC_4SAMPLES
	
	config BM1422_AVC_NONE
		bool "No Averaging"
	
	config BM1422_AVC_2SAMPLES
		bool "2 Samples Averaged"
		
	config BM1422_AVC_4SAMPLES
		bool "4 Samples Averaged"
	
	config BM1422_AVC_8SAMPLES
		bool "8 Samples Averaged"
	
	config BM1422_AVC_16SAMPLES
		bool "16 Samples Averaged"
		
endchoice


choice
	prompt "Magnetometer sampling frequency (ODR)"
	default BM1422_ODR_10HZ
		
	config BM1422_ODR_10HZ
		bool "10 Hz"

	config BM1422_ODR_20HZ
		bool "20 Hz"

	config BM1422_ODR_100HZ
		bool "100 Hz"

	config BM1422_ODR_1KHZ
		bool "1000 Hz"
		
endchoice


menuconfig BM1422_DREN
	bool "DRDY Interrupt Pin"
	
config BM1422_DRP
	bool "DRDY Interrupt Pin Level Control"
	depends on BM1422_DREN
	help
		n: active LOW, y: active HIGH
	

choice
	prompt "Trigger mode"
	default BM1422_TRIGGER_OWN_THREAD
	help
	  Specify the type of triggering used by the driver.

config BM1422_TRIGGER_NONE
	bool "No trigger"

config BM1422_TRIGGER_GLOBAL_THREAD
	bool "Use global thread"
	depends on GPIO
	select BM1422_TRIGGER

config BM1422_TRIGGER_OWN_THREAD
	bool "Use own thread"
	depends on GPIO
	select BM1422_TRIGGER

endchoice

config BM1422_TRIGGER
	bool

config BM1422_THREAD_PRIORITY
	int "Thread priority"
	depends on BM1422_TRIGGER_OWN_THREAD && BM1422_TRIGGER
	default 10
	help
		Priority of thread used by the driver to handle interrupts.

config BM1422_THREAD_STACK_SIZE
	int "Thread stack size"
	depends on BM1422_TRIGGER_OWN_THREAD && BM1422_TRIGGER
	default 1024
	help
		Stack size of thread used by the driver to handle interrupts.

endif # BM1422
```

## drivers/ch201/Kconfig
```kconfig
# Long-Range Ultrasonic Time of Flight Sensor

# Copyright (c) 2021 Griffin Adams
# SPDX-License-Identifier: Apache-2.0

menuconfig CH201
	bool "CH201 Ultrasonic ToF Sensor"
	depends on I2C
	help
		Enable driver for CH201 Ultrasonic ToF Sensor.

if CH201

module = CH201
module-str = CH201
source "subsys/logging/Kconfig.template.log_config"

choice
	prompt "Output Data Bit"
	default CH201_12_BIT

	config CH201_12_BIT
		bool "12-bit Output"
		  
	config CH201_14_BIT
		bool "14-bit Output"
		  
endchoice

choice
	prompt "Averaging Filter Control"
	default CH201_AVC_4SAMPLES
	
	config CH201_AVC_NONE
		bool "No Averaging"
	
	config CH201_AVC_2SAMPLES
		bool "2 Samples Averaged"
		
	config CH201_AVC_4SAMPLES
		bool "4 Samples Averaged"
	
	config CH201_AVC_8SAMPLES
		bool "8 Samples Averaged"
	
	config CH201_AVC_16SAMPLES
		bool "16 Samples Averaged"
		
endchoice


choice
	prompt "Magnetometer sampling frequency (ODR)"
	default CH201_ODR_10HZ
		
	config CH201_ODR_10HZ
		bool "10 Hz"

	config CH201_ODR_20HZ
		bool "20 Hz"

	config CH201_ODR_100HZ
		bool "100 Hz"

	config CH201_ODR_1KHZ
		bool "1000 Hz"
		
endchoice


menuconfig CH201_DREN
	bool "DRDY Interrupt Pin"
	
config CH201_DRP
	bool "DRDY Interrupt Pin Level Control"
	depends on CH201_DREN
	help
		n: active LOW, y: active HIGH
	

choice
	prompt "Trigger mode"
	default CH201_TRIGGER_OWN_THREAD
	help
	  Specify the type of triggering used by the driver.

config CH201_TRIGGER_NONE
	bool "No trigger"

config CH201_TRIGGER_GLOBAL_THREAD
	bool "Use global thread"
	depends on GPIO
	select CH201_TRIGGER

config CH201_TRIGGER_OWN_THREAD
	bool "Use own thread"
	depends on GPIO
	select CH201_TRIGGER

endchoice

config CH201_TRIGGER
	bool

config CH201_THREAD_PRIORITY
	int "Thread priority"
	depends on CH201_TRIGGER_OWN_THREAD && CH201_TRIGGER
	default 10
	help
		Priority of thread used by the driver to handle interrupts.

config CH201_THREAD_STACK_SIZE
	int "Thread stack size"
	depends on CH201_TRIGGER_OWN_THREAD && CH201_TRIGGER
	default 1024
	help
		Stack size of thread used by the driver to handle interrupts.

endif # CH201
```

## drivers/dts/bindings/kionix,kx134-1211-spi.yaml
```yaml
# Copyright (c) 2021 Griffin Adams
# SPDX-License-Identifier: Apache-2.0

description: KX134-1211 3-axis high-g accelerometer, accessed through SPI bus

compatible: "kionix,kx134-1211"

include: spi-device.yaml

properties:
    irq-gpios:
      type: phandle-array
      required: false
      description: |
        The INT1 signal defaults to active high as produced by the
        sensor.  The property value should ensure the flags properly
        describe the signal that is presented to the driver.
    wakeup-gpios:
      type: phandle-array
      required: false
      description: |
        The trigger signal defaults to active high as produced by the
        MCU.  The property value should ensure the flags properly
        describe the signal that is presented to the driver.
```
